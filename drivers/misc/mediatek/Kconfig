## drivers/misc/mediatek/Kconfig
```kconfig
menuconfig MEDIATEK_SOLUTION
	bool "MediaTek Properitary Configuration"
	select FW_LOADER_USER_HELPER_FALLBACK
	help
	  Check this to enable MediaTek properity configuration.

if MEDIATEK_SOLUTION
source "drivers/misc/mediatek/ram_console/Kconfig"
endif
```
